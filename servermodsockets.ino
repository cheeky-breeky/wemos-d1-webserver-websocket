#include <ESP8266WiFi.h>
#include <WiFiClient.h>
#include <ESP8266WebServer.h>

#include <WebSocketsServer.h>


#ifndef APSSID
#define APSSID "ECGnet"
#define APPSK  ""
#endif

WebSocketsServer webSocket = WebSocketsServer(81);

const char *page_index = R"=====(
<!DOCTYPE html>
<html>
  <head>
    <title>tim's page</title>
    <script src='zuri.js'></script>
    <style>
      body{
        background-color:#9e9e9e;
      }
    </style>
  </head>
  <body>
    <h2>mini HR monitor</h2>
    <canvas id='gc' width='680' height='400'></canvas>
    <img src="images/lead3.gif" alt="lead placement">
  </body>
</html>
)=====";

const char *js_code = R"=====(
  var gc;
  var c;
 
  var time = 0;
 
  var conv = 2 * Math.PI;
 
  var wav1 = [];
  var wav2 = [];
  var wav3 = [];

  //var Socket;

  var frames;
  var skip;

  var HR = "---";

  var avgHR = [];

  var handle_timer;
 
  window.onload = function() {
    gc = document.getElementById('gc');
    c = gc.getContext('2d')

    Socket = new WebSocket('ws://' + window.location.hostname + ':81/');
    Socket.onmessage = function(event) {
      ++skip;
      if(skip & 0x01) wav3.unshift(event.data);
      //Socket.send('.');
      ++frames;
    }
    Socket.onopen = function() {
      Socket.send('.');
      console.log('here');
    }
    Socket.onclose = function() {
      console.log('died');
    }

    frames = 0;
    skip = 0;
   
    setInterval(game, 1000/15);
    handle_timer = setInterval(reset_hr, 2000);
  }

  function reset_hr() {
    HR = "---";
    avgHR = [];
  }
 
  function game() {
    c.lineWidth = 1;
    c.fillStyle = 'gray';
    c.fillRect(0, 0, gc.width, gc.height);
   
    [nx, ny] = make_circle(50, 15, 10, time);
    wav1.unshift(ny);

    c.beginPath();
    c.strokeStyle = 'orange';
    c.moveTo(nx, ny);
    c.lineTo(100, ny);
    c.stroke();
   
    c.beginPath();
    c.strokeStyle = 'white';
    for(x= 0; x< wav1.length; ++x) c.lineTo(x + 100, wav1[x]);
    c.stroke();
   
    while(wav1.length > 500) wav1.pop();
    while(wav3.length > 500) wav3.pop();

    normalize_mult();

    calc_HR();

    c.fillStyle = 'green';
    c.font = 'bold 64px Unknown Font, sans-serif';
    c.fillText(HR, 20, 380);
   
    frames = 0;
   
    time += 10;
  }

  function calc_HR() {
    var max0 = 0;
    var min0 = 2000;
   
    var threshold;
    var peakFound;
   
    var canAdd = false;
    var markers = [];
   
    for(x= 0; x< wav3.length; ++x) {
      if(wav3[x] > max0) max0 = wav3[x];
      if(wav3[x] < min0) min0 = wav3[x];
    }

    if((max0 - min0) > 50) {
   
      threshold = (0.2 * (max0 - min0)) + min0; // 80% between min and max
     
      peakFound = false;
      for(x= 0; x< wav3.length; ++x) {
        if(canAdd == false) {
          if(wav3[x] > threshold) canAdd = true;
        } else if(wav3[x] < threshold) {
          if(peakFound == false) {
            peakFound = true;
            // draw red marker
            //if(canAdd) {
              c.beginPath();
              c.strokeStyle = 'red';
              c.moveTo(580 - x, (400 - ((wav3[x] * 400) / 1024)) + 5);
              c.lineTo(580 - x, (400 - ((wav3[x] * 400) / 1024)) - 5);
              c.stroke();
              // make markers
              markers.unshift(x);
              //
              clearInterval(handle_timer);
              handle_timer = setInterval(reset_hr, 2000);
              // skip some vals
              x += 5;
            //}
          }
        } else {
          peakFound = false;
        }
      }
     
      while(markers.length > 2) markers.pop();
     
      if(markers.length == 2) {
        //var rollsum = 0;
        HR = Math.abs(markers[0] - markers[1]);
        //rollsum += Math.abs(markers[1] - markers[2]);
        //rollsum += Math.abs(markers[2] - markers[3]);
       // rollsum += Math.abs(markers[3] - markers[4]);
       
        //HR = Math.round(rollsum);
        HR /= ((frames * 15) / 2);
        HR = 1 / HR;
        HR = Math.round(HR * 60);
 
        avgHR.unshift(HR);
 
        while(avgHR.length > 128) avgHR.pop();
 
        var sum = 0;
        for(x = 0; x< avgHR.length; ++x) {
          sum += avgHR[x];
        }
 
        HR = Math.round(sum / avgHR.length);
       
        if((HR < 5) || (HR > 250)) HR = "---";
      }
    }
  }
 
  function make_circle(x, y, r, a) {
    // draw circle
    c.beginPath();
    c.strokeStyle = 'blue';
    c.arc(x, y, r, 0, conv);
    c.stroke();

    // caculate line coordinates
    let ad = r * Math.cos((conv * a) / 360);
    let op = r * Math.sin((conv * a) / 360);

    // plot line
    c.beginPath();
    c.strokeStyle = 'white';
    c.moveTo(x, y);
    c.lineTo(x + ad, y + op);
    c.stroke();

    // return line coordinates
    return [x + ad, y + op];
  }
 
  function normalize_mult() {    
    c.beginPath();
    c.lineWidth = 2;
    c.strokeStyle = '#62ff00';
    for(x= 0; x< wav3.length; ++x) {
      //wav3[x] =
      c.lineTo(580 - x, 400 - ((wav3[x] * 400) / 1024));
    }
    c.stroke();
  }
)=====";

/* Set these to your desired credentials. */
const char *ssid = APSSID;
const char *password = APPSK;

int val;

uint8_t client_num;

int doSomething = false;

unsigned long startTime;
unsigned long endTime;

ESP8266WebServer server(80);

/* Just a little test message.  Go to http://192.168.4.1 in a web browser
   connected to this access point to see it.
*/
void handleRoot() {
  server.send(200, "text/html", page_index);
}

void handleJS() {
  server.send(200, "text/script", js_code);
}

void handleADC() {
  val = analogRead(A0);
  server.send(200, "text/html", String(val));
}

void handleFavicon() {
  static const uint8_t gif[] PROGMEM = {
      0x47, 0x49, 0x46, 0x38, 0x37, 0x61, 0x10, 0x00, 0x10, 0x00, 0x80, 0x01,
      0x00, 0x00, 0x00, 0x00, 0xff, 0xff, 0xff, 0x2c, 0x00, 0x00, 0x00, 0x00,
      0x10, 0x00, 0x10, 0x00, 0x00, 0x02, 0x19, 0x8c, 0x8f, 0xa9, 0xcb, 0x9d,
      0x00, 0x5f, 0x74, 0xb4, 0x56, 0xb0, 0xb0, 0xd2, 0xf2, 0x35, 0x1e, 0x4c,
      0x0c, 0x24, 0x5a, 0xe6, 0x89, 0xa6, 0x4d, 0x01, 0x00, 0x3b
    };
    char gif_colored[sizeof(gif)];
    memcpy_P(gif_colored, gif, sizeof(gif));
    // Set the background to a random set of colors
    gif_colored[16] = random(0, 255);//millis() % 256;
    gif_colored[17] = random(0, 255);//millis() % 256;
    gif_colored[18] = random(0, 255);//millis() % 256;
    server.send(200, "image/gif", gif_colored, sizeof(gif_colored));
}

void handleImage() {
  static const uint8_t gif[] PROGMEM = {
          0x47, 0x49, 0x46, 0x38, 0x39, 0x61, 0x3c, 0x00, 0x39, 0x00, 0xf7, 0x00, 0x00, 0x00, 0x00, 0x00, 0x00, 0x00, 0x33, 0x00, 0x00, 0x66, 0x00, 0x00, 0x99, 0x00, 0x00, 0xcc, 0x00, 0x00, 0xff, 0x00, \
          0x2b, 0x00, 0x00, 0x2b, 0x33, 0x00, 0x2b, 0x66, 0x00, 0x2b, 0x99, 0x00, 0x2b, 0xcc, 0x00, 0x2b, 0xff, 0x00, 0x55, 0x00, 0x00, 0x55, 0x33, 0x00, 0x55, 0x66, 0x00, 0x55, 0x99, 0x00, 0x55, 0xcc, \
          0x00, 0x55, 0xff, 0x00, 0x80, 0x00, 0x00, 0x80, 0x33, 0x00, 0x80, 0x66, 0x00, 0x80, 0x99, 0x00, 0x80, 0xcc, 0x00, 0x80, 0xff, 0x00, 0xaa, 0x00, 0x00, 0xaa, 0x33, 0x00, 0xaa, 0x66, 0x00, 0xaa, \
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          0x00, 0x3b
    };
    char gif_colored[sizeof(gif)];
    memcpy_P(gif_colored, gif, sizeof(gif));
    server.send(200, "image/gif", gif_colored, sizeof(gif_colored));
}


void webSocketEvent(uint8_t num, WStype_t type, uint8_t * payload, size_t length) {

    switch(type) {
        case WStype_DISCONNECTED:
            Serial.printf("[%u] Disconnected!\n", num);
            doSomething = false;
            break;
        case WStype_CONNECTED:
            {
                IPAddress ip = webSocket.remoteIP(num);
                Serial.printf("[%u] Connected from %d.%d.%d.%d url: %s\n", num, ip[0], ip[1], ip[2], ip[3], payload);
                client_num = num;
                doSomething = true;
            }
            break;
        case WStype_TEXT:
            //Serial.printf("[%u] get Text: %s\n", num, payload);

            // send message to client
            //webSocket.sendTXT(num, "1234");
            //client_num = num;

            //doSomething = true;

            // send data to all connected clients
            // webSocket.broadcastTXT("message here");
            break;
        case WStype_BIN:
            Serial.printf("[%u] get binary length: %u\n", num, length);
            hexdump(payload, length);

            // send message to client
            // webSocket.sendBIN(num, payload, length);
            break;
    }

}

void setup() {
  delay(1000);
  Serial.begin(115200);
  Serial.println();
  Serial.print("Configuring access point...");
  WiFi.softAP(ssid);

  IPAddress myIP = WiFi.softAPIP();
  Serial.print("AP IP address: ");
  Serial.println(myIP);
  webSocket.begin();
  webSocket.onEvent(webSocketEvent);
  server.on("/", handleRoot);
  server.on("/zuri.js", handleJS);
  server.on("/favicon.ico", handleFavicon);
  server.on("/images/lead3.gif", handleImage);
  server.on("/adc.txt", handleADC);
  server.begin();
  Serial.println("HTTP server started");

  // try to use a timer
  startTime = millis();
  //pinMode(D2, INPUT);
  //digitalWrite(D2, LOW);
}

void loop() {
  webSocket.loop();
  server.handleClient();

  endTime = millis();
  //pinMode(D2, INPUT);
  if ((endTime - startTime) > 6) {
    startTime = endTime;
    if(doSomething) {
      String data = "";
      val = analogRead(A0);
      data += String(val);
      webSocket.sendTXT(client_num, data);
      //doSomething = false;
    }
  }
}
